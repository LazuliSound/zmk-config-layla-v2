## config/boards/shields/layla_v2/Kconfig.defconfig
```kconfig
if SHIELD_LAYLA_RIGHT

config ZMK_KEYBOARD_NAME
    default "LaylaV2"

config ZMK_SPLIT_ROLE_CENTRAL
    default y

config ZMK_POINTING
    default y
    
config I2C
    default y

endif # RIGHT

if SHIELD_LAYLA_LEFT || SHIELD_LAYLA_RIGHT

config ZMK_SPLIT
    default y

endif # LEFT RIGHT
```

## config/boards/shields/layla_v2/Kconfig.shield
```kconfig
config SHIELD_LAYLA_LEFT
    def_bool $(shields_list_contains,layla_left)

config SHIELD_LAYLA_RIGHT
    def_bool $(shields_list_contains,layla_right)
```
